#include <Wire.h>
#include <Adafruit_SSD1306.h>
#include <Adafruit_GFX.h>
#include <Fonts/FreeSans9pt7b.h>
#include <Fonts/FreeSans12pt7b.h>
#include <Fonts/FreeSans18pt7b.h>
#include <SoftwareSerial.h>
#include <DFPlayer_Mini_Mp3.h>

SoftwareSerial serial(10, 11);

#define SCREEN_WIDTH 128                // OLED display width
#define SCREEN_HEIGHT 64                // OLED display height

#define OLED_RESET     4      // Reset pin # (or -1 if sharing Arduino reset pin)
Adafruit_SSD1306 oled(SCREEN_WIDTH, SCREEN_HEIGHT, &Wire, OLED_RESET);
//Adafruit_SSD1306 oled1(SCREEN_WIDTH, SCREEN_HEIGHT, &Wire, OLED_RESET);
//Adafruit_SSD1306 display(OLED_RESET);`
//Adafruit_SSD1306 display1(OLED_RESET);

#define btnUp   2
#define btnOk   3
#define btnDown 4
#define btnBack 5
#define btnNext 6

boolean statusBtnUp   = false;
boolean statusBtnOk   = false;
boolean statusBtnDown = false;
boolean statusBtnBack = false;
boolean statusBtnNext = false;

boolean statusAkhirBtnUp   = false;
boolean statusAkhirBtnOk   = false;
boolean statusAkhirBtnDown = false;
boolean statusAkhirBtnBack = false;
boolean statusAkhirBtnNext = false;

boolean UP   = false;
boolean OK   = false;
boolean DOWN = false;
boolean BACK = false;
boolean NEXT = false;

int bar = 1;
int slide = 1;

char opening[] = "READY?!   3...   2..    1.    GO!";
//char AiO[] = "Astronot In The Ocean - MASKED WOLF";
char PM[] = "Portal Mysterious Space Background Music";
char decision[] = "DECISION";
char despair[] = "DESPAIR";
char samidare[] = "SAMIDARE";
int x, minO, minP, minQ, minR, minX, minA, minB, minC, minD;
char kata1[] = "Hallo Sahabat, KPM adalah organisasi yang bergerak di bidang penelitian";
char kata2[] = "Penelitian meliputi eksakta, sosial, dan penerapan";
char kata3[] = "Di sini kamu akan bertemu orang-orang hebat yang bersama-sama mengasah skill menulis dan meneliti";
char kata4[] = "Kamu tidak usah khawatir di sini kita sama-sama belajar dan saling berkolaborasi menciptakan hal-hal keren";
int urutan_lagu = 0;
int urutan_kata = 0;
//unsigned long t0 = 0;
//unsigned long t0_a = 0;
//unsigned long interval = 150;
// 'LOGO KPM UNJ HD', 128x64px
const unsigned char LOGO_KPM [] PROGMEM = {
  0xfe, 0x00, 0x7f, 0xff, 0xff, 0xff, 0xff, 0xff, 0xff, 0xff, 0xff, 0xff, 0xff, 0xff, 0xff, 0xff, 
  0xf3, 0xff, 0xcf, 0xff, 0xff, 0xff, 0xff, 0xff, 0xff, 0xff, 0xff, 0xff, 0xff, 0xff, 0xff, 0xff, 
  0xcf, 0xe7, 0xf3, 0xff, 0xff, 0xff, 0xff, 0xff, 0xff, 0xff, 0xff, 0xff, 0xff, 0xff, 0xff, 0xff, 
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  0xff, 0xfd, 0x7b, 0xfb, 0xdb, 0x6d, 0xbb, 0x6d, 0xfb, 0xeb, 0xa7, 0xdb, 0xbd, 0xb7, 0xff, 0xff
};

void setup() {

  oled.begin(SSD1306_SWITCHCAPVCC, 0x3C);
  oled.setTextColor(WHITE);
  oled.setTextWrap(false);
  x = oled.width();
  minX = -12*strlen(opening);
  minO = -12*strlen(PM);
  minP = -12*strlen(decision);
  minQ = -12*strlen(despair);
  minR = -12*strlen(samidare);
  minA = -12*strlen(kata1);
  minB = -12*strlen(kata2);
 // minC = -12*strlen(kata3);
 // minD = -12*strlen(kata4);
 // oled.setFont(&FreeSans9pt7b);
  oled.clearDisplay();
  oled.drawBitmap(0, 0, LOGO_KPM, 128, 64, WHITE);
  oled.display();
  delay(5000);
  for(int j=0; j <= 121; j++){ 
  oled.clearDisplay();
  oled.setTextColor(WHITE);
  oled.setTextSize(1);
  oled.setCursor(30, 0);
  oled.print("LOADING...");
  oled.drawRect(1, 25, 125, 15, 1); 
  oled.fillRect(3, 27, j, 11, 1);
  oled.display();
  }
  delay(7000);

 // delay(9000);
/*  oled.setTextWrap(false);
  x = oled.width();
  minX = -12*strlen(opening);
  oled.clearDisplay();
  oled.setCursor(0,0);
  oled.setTextSize(1);
  oled.print("Test Scrolling Text");
  oled.setTextSize(1);
  oled.setCursor(x, 15);
  oled.print(opening);
  oled.display();
  x = x - 4;
  if(x < minX) x = oled.width();*/

 /* oled1.begin(SSD1306_SWITCHCAPVCC, 0x3C);
  oled1.clearDisplay();
  oled1.display();*/
  serial.begin(9600);
  mp3_set_serial(serial);
  delay(10);
  mp3_set_volume(40);
  delay(5);

  pinMode(btnUp,   INPUT_PULLUP);
  pinMode(btnOk,   INPUT_PULLUP);
  pinMode(btnDown, INPUT_PULLUP);
  pinMode(btnBack, INPUT_PULLUP);
  pinMode(btnNext, INPUT_PULLUP);
}

void loop() {
//  unsigned long tb = millis();

  //if(tb - t0 >= interval){
  tampil();
//  }
 /*if(tb - t0_a >= interval){
    oled1.clearDisplay();
    oled1.setTextColor(WHITE);
    oled1.setTextSize(1);
    oled1.setCursor(0, 20);
    oled1.print("Kita Coba");
    oled1.display();
  } */ 
  
  statusBtnUp   = digitalRead(btnUp);
  statusBtnOk   = digitalRead(btnOk);
  statusBtnDown = digitalRead(btnDown);
  statusBtnBack = digitalRead(btnBack);
  statusBtnNext = digitalRead(btnNext);

  saatUpDitekan();
  saatOkDitekan();
  saatDownDitekan();
  saatBackDitekan();
  saatNextDitekan();

  if(UP && slide == 1 ){ 
    UP = false;
    bar --;
    if(bar < 1){
      bar = 3;
    }  
  }

  if(DOWN && slide == 1){ 
    DOWN = false;
    bar ++;
    if(bar > 3){
      bar = 1;
    } }

  if (OK) {
    OK = false;
    if(bar == 1 && slide == 1){
      slide = 2;
      delay(300);
    }if(bar == 2 && slide == 1){
      slide = 3;
      delay(300);
    }if(bar == 3 && slide == 1){
      slide = 4;
      delay(300);
    }
    }

    if (BACK) {
    BACK = false;
    if (slide == 2 || slide == 3 || slide == 4) {
      slide = 1;
    }
  }

  if (NEXT){
    NEXT = false;
    if(slide == 3){ mp3_next(); urutan_lagu ++;
    if(urutan_lagu > 3){
      urutan_lagu = 0; }
    } if(slide == 4){
      urutan_kata ++;
      if(urutan_kata > 1){
        urutan_kata = 0;
      }
    }
  }

  
}


//------------------------------------------------------------------------//
void saatUpDitekan() {
  if (statusBtnUp != statusAkhirBtnUp) {
    if (statusBtnUp == 0) {
      UP = true;
    }
    delay(50);
  }
  statusAkhirBtnUp = statusBtnUp;
}

void saatOkDitekan() {
  if (statusBtnOk != statusAkhirBtnOk) {
    if (statusBtnOk == 0) {
      OK = true;
    }
    delay(50);
  }
  statusAkhirBtnOk = statusBtnOk;
}

void saatDownDitekan() {
  if (statusBtnDown != statusAkhirBtnDown) {
    if (statusBtnDown == 0) {
      DOWN = true;
    }
    delay(50);
  }
  statusAkhirBtnDown = statusBtnDown;
}

void saatBackDitekan() {
  if (statusBtnBack != statusAkhirBtnBack) {
    if (statusBtnBack == 0) {
      BACK = true;
    }
    delay(50);
  }
  statusAkhirBtnBack = statusBtnBack;
}

void saatNextDitekan(){
   if (statusBtnNext != statusAkhirBtnNext) {
    if (statusBtnNext == 0) {
      NEXT = true;
    }
    delay(50);
  }
  statusAkhirBtnNext = statusBtnNext;
}

//---------------------------------------------------------------------------------------

void tampil(){
  
 if (slide == 1){
  oled.clearDisplay();
  oled.setTextSize(1);
  oled.setTextColor(WHITE);
  oled.setCursor(15, 0);
  oled.print("Kelompok Peneliti");
  oled.setCursor(55, 8);
  oled.print("Muda");
  //oled1.clearDisplay();
  /*oled1.setTextSize(1);
  oled1.setTextColor(WHITE);*/


  if(bar == 1){
    oled.setCursor(6, 22);
    oled.setTextColor(BLACK, WHITE);
    oled.print("> INTRO");
    /*oled1.setCursor(6, 17);
    oled1.setTextColor(BLACK, WHITE);
    oled1.print("> INTRO");*/

  }else{
     oled.setCursor(6, 22);
     oled.setTextColor(WHITE);
     oled.print("  INTRO");
     /*oled1.setCursor(6, 17);
     oled1.setTextColor(WHITE);
     oled1.print("  INTRO");*/

   
   }
  if(bar == 2){
    oled.setCursor(6, 35);
    oled.setTextColor(BLACK, WHITE);
    oled.print("> MUSIK");
    /*oled1.setCursor(6, 30);
    oled1.setTextColor(BLACK, WHITE);
    oled1.print("> MUSIK");*/


  }else{
     oled.setCursor(6, 35);
     oled.setTextColor(WHITE);
     oled.print("  MUSIK");
     /*oled1.setCursor(6, 30);
     oled1.setTextColor(WHITE);
     oled1.print("  MUSIK");*/


   }
  if(bar == 3){
    oled.setCursor(6, 48);
    oled.setTextColor(BLACK, WHITE);
    oled.print("> ISI");
    /*oled1.setCursor(6, 43);
    oled1.setTextColor(BLACK, WHITE);
    oled1.print("> ENTAHLAH");*/


  }else{
     oled.setCursor(6, 48);
     oled.setTextColor(WHITE);
     oled.print("  ISI");
     /*oled1.setCursor(6, 43);
     oled1.setTextColor(WHITE);
     oled1.print("  ENTAHLAH");*/

   
   }
   //mp3_stop();
 } else if(slide == 2){
  oled.clearDisplay();
  oled.setCursor(30,0);
  oled.setTextSize(2);
  oled.print("INTRO");
  oled.setTextSize(2);
  oled.setCursor(x, 30);
  oled.print(opening);
  oled.display();
  x = x-3;
  if(x < minX) x = oled.width();
 } else if(slide == 3){
   mp3_play();
   cobadulu();
 } else if(slide == 4){
  //mp3_stop();
   //tesdulu();
 oled.clearDisplay();
 oled.setTextSize(2);
 oled.setCursor(0, 0);
 oled.setTextColor(WHITE);
 oled.print("PRAKATA");
 oled.drawRect(95, 1, 4, 15, 1);
 oled.drawRect(101, 1, 4, 15, 1);
 oled.drawRect(107, 1, 4, 15, 1);
 oled.drawLine(0, 23, 128, 23, 1);
 oled.drawLine(0, 50, 128, 50, 1);
 
  
 if (urutan_kata == 0){
   
  oled.setTextSize(2);
  oled.setCursor(x, 30);
  oled.print(kata1);
 // oled.display();
  x = x-3;
  if(x < minA) x = oled.width();
   
 } 
 if (urutan_kata == 1){
  oled.setTextSize(2);
  oled.setCursor(x, 30);
  oled.print(kata2);
 // oled.display();
  x = x-3;
  if(x < minB) x = oled.width(); 
 } 

 }
 
 oled.display();
 oled.clearDisplay();
 
}

void cobadulu(){
   oled.clearDisplay();
   oled.setTextSize(2);
   oled.setCursor(10, 0);
   oled.setTextColor(WHITE);
   oled.print("~ MUSIK ~");
 if (urutan_lagu == 0){
   
  oled.setTextSize(2);
  oled.setCursor(x, 30);
  oled.print(samidare);
 // oled.display();
  x = x-3;
  if(x < minO) x = oled.width();
   /*oled.setTextSize(1);
   oled.setCursor(0, 20);
   oled.setTextColor(WHITE);
   oled.print("Astronot In Ocean");*/
 } 
 if (urutan_lagu == 1){
  oled.setTextSize(2);
  oled.setCursor(x, 30);
  oled.print(PM);
 // oled.display();
  x = x-3;
  if(x < minP) x = oled.width();
 
 } 
 if (urutan_lagu == 2){
   oled.setTextSize(2);
   oled.setCursor(x, 30);
   oled.print(decision);
  // oled.display();
   x = x-3;
   if(x < minQ) x = oled.width();
   
 } 
 if (urutan_lagu == 3){
  oled.setTextSize(2);
  oled.setCursor(x, 30);
  oled.print(despair);
  // oled.display();
  x = x-3;
  if(x < minR) x = oled.width();
 } 
 oled.display();
}
